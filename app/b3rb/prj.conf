## prj.conf
```kconfig
CONFIG_CEREBRI_APP_NAME="b3rb"

CONFIG_SYS_CLOCK_TICKS_PER_SEC=10000
CONFIG_TICKLESS_KERNEL=n

CONFIG_CEREBRI_DREAM_SIL=n

CONFIG_CEREBRI_B3RB_ESTIMATE=y
CONFIG_CEREBRI_B3RB_FSM=y
CONFIG_CEREBRI_B3RB_MANUAL=y
CONFIG_CEREBRI_B3RB_MIXING=y
CONFIG_CEREBRI_B3RB_POSITION=n
CONFIG_CEREBRI_B3RB_VELOCITY=y
CONFIG_CEREBRI_B3RB_LIGHTING=y
CONFIG_CEREBRI_B3RB_CASADI=y

CONFIG_CEREBRI_ACTUATE_PWM=y
CONFIG_CEREBRI_ACTUATE_LED_ARRAY=y
CONFIG_CEREBRI_ACTUATE_SOUND=y

CONFIG_NET_BUF_RX_COUNT=24
CONFIG_NET_PKT_RX_COUNT=24

CONFIG_CEREBRI_SENSE_POWER=y
CONFIG_CEREBRI_SENSE_SAFETY=y
CONFIG_CEREBRI_SENSE_IMU=y
CONFIG_CEREBRI_SENSE_MAG=y
CONFIG_CEREBRI_SENSE_WHEEL_ODOMETRY=y
CONFIG_CEREBRI_SENSE_UBX_GNSS=y

CONFIG_CEREBRI_SYNAPSE_ETH_RX=y
CONFIG_CEREBRI_SYNAPSE_ETH_TX=y
CONFIG_CEREBRI_SYNAPSE_ETHERNET=n

CONFIG_CEREBRI_SYNAPSE_TOPIC=y
CONFIG_CEREBRI_CORE_COMMON=y
CONFIG_CEREBRI_CORE_COMMON_BOOT_BANNER=y
CONFIG_CEREBRI_SYNAPSE_ZROS=y

CONFIG_SHELL_STACK_SIZE=10240
CONFIG_INIT_STACKS=y

CONFIG_LOG=y
CONFIG_LOG_CMDS=y
CONFIG_LOG_MODE_DEFERRED=y

CONFIG_ASSERT=y
CONFIG_TEST=y
CONFIG_CBPRINTF_FP_SUPPORT=y

# modules
CONFIG_SYNAPSE_PROTOBUF=y
CONFIG_SYNAPSE_TINYFRAME=y
CONFIG_NANOPB=y
CONFIG_UBXLIB=y

# Debug
CONFIG_CEREBRI_SENSE_WHEEL_ODOMETRY_LOG_LEVEL_DBG=n
CONFIG_CEREBRI_SENSE_IMU_LOG_LEVEL_DBG=n
CONFIG_CEREBRI_SENSE_SAFETY_LOG_LEVEL_DBG=n

# General config
CONFIG_POSIX_API=y
CONFIG_NEWLIB_LIBC=y
CONFIG_MAIN_THREAD_PRIORITY=5
CONFIG_SYSTEM_WORKQUEUE_PRIORITY=-2
CONFIG_SYS_CLOCK_TICKS_PER_SEC=10000
# Networking config
CONFIG_NET_SHELL=y
CONFIG_NETWORKING=y
CONFIG_NET_IPV4=y
CONFIG_NET_IPV6=n
CONFIG_NET_TCP=y
CONFIG_NET_SOCKETS=y

# Network address config
CONFIG_NET_CONFIG_SETTINGS=y
CONFIG_NET_STATISTICS=y
CONFIG_NET_MGMT_EVENT_INFO=y
CONFIG_NET_MGMT_EVENT_MONITOR=y
CONFIG_NET_BUF_POOL_USAGE=y
CONFIG_NET_DEBUG_NET_PKT_ALLOC=y
CONFIG_NET_CONFIG_NEED_IPV4=y
CONFIG_NET_CONFIG_MY_IPV4_ADDR="192.0.2.1"
CONFIG_NET_CONFIG_PEER_IPV4_ADDR="192.0.2.2"

# STATS
CONFIG_THREAD_RUNTIME_STATS=y
CONFIG_SCHED_THREAD_USAGE=y
CONFIG_SCHED_THREAD_USAGE_ANALYSIS=y
CONFIG_SCHED_THREAD_USAGE_ALL=y
CONFIG_SCHED_THREAD_USAGE_AUTO_ENABLE=y
```

## src/vector_utility.h
```c
/**
 * @file vector_utility.h
 * @brief Fichier contenant les fonctions relatives à la manipulation des vecteurs
 *
 * @author Antoine Guillermin
 * @date 2024-04-18
 * @version 1.501
 */
#ifndef VECTOR_UTILITY
#define VECTOR_UTILITY

#define VECTEUR_FALSE 0
#define VECTEUR_TRUE 1

double epsilon = 1e-9;  // définir une tolérance

/**
 * @brief Convertit des vecteurs Pixy en vecteurs D.
 *
 * @param pixy_vector Le vecteur Pixy.
 * @param vecteurs Les vecteurs D résultants.
 */
void pixyVecteursToDVecteurs(synapse_msgs_PixyVector pixy_vector,
                             DVecteur* vecteurs);

/**
 * @brief Initialise un vecteur à zéro.
 *
 * @param vecteurs Le vecteur à initialiser.
 */
void setNullVecteur(DVecteur* vecteurs);

/**
 * @brief Convertit des vecteurs D en vecteurs Pixy.
 *
 * @param vecteurs Les vecteurs D.
 * @param pixy_vector Le vecteur Pixy résultant.
 */
void DVecteursToPixyVecteurs(DVecteur vecteurs,
                             synapse_msgs_PixyVector* pixy_vector);

/**
 * @brief Vérifie si un vecteur est nul.
 *
 * @param vecteur Le vecteur à vérifier.
 * @return int Retourne VECTEUR_FALSE si le vecteur est non nul, sinon VECTEUR_TRUE.
 */
int isNullVecteur(Vecteur* vecteur);

/**
 * @brief Obtient le nombre de vecteurs non nuls dans un ensemble de vecteurs D.
 *
 * @param vecteurs Les vecteurs D.
 * @return int Le nombre de vecteurs non nuls.
 */
int getNbOfNonNullVecteurs(DVecteur* vecteurs);

/**
 * @brief Arrange les vecteurs pour que y0 soit toujours inférieur à y1.
 *
 * @param vecteurs Les vecteurs à arranger.
 */
void arrangeVecteurs(DVecteur* vecteurs);

/**
 * @brief Ajoute des vecteurs à une liste dans un contexte donné.
 *
 * @param vecteurs Les vecteurs à ajouter.
 * @param ctx Le contexte dans lequel ajouter les vecteurs.
 * @param nbVecteurs Le nombre de vecteurs à ajouter.
 */
void addVecteursToList(DVecteur vecteurs, context* ctx, int nbVecteurs);

/**
 * @brief Calcule le vecteur moyen à partir d'un ensemble de vecteurs.
 *
 * @param vecteurs Les vecteurs à utiliser.
 * @param size La taille de l'ensemble de vecteurs.
 * @param average_vecteur Le vecteur moyen résultant.
 */
void calculateAverageVecteur(DVecteur* vecteurs, int size,
                             DVecteur* average_vecteur);

/**
 * @brief Calcule la distance entre deux vecteurs D.
 *
 * @param v1 Le premier vecteur.
 * @param v2 Le deuxième vecteur.
 * @return double La distance entre les deux vecteurs.
 */
double calculateVecteursDistance(DVecteur v1, DVecteur v2);

/**
 * @brief Supprime les vecteurs aberrants d'un ensemble de vecteurs.
 *
 * @param vecteurs Les vecteurs à traiter.
 * @param size La taille de l'ensemble de vecteurs.
 * @param avg_vector Le vecteur moyen.
 * @param threshold Le seuil pour déterminer les vecteurs aberrants.
 */
void removeOutliersVecteurs(DVecteur* vecteurs, int* size, DVecteur* avg_vector,
                            double threshold);

/**
 * @brief Calcule le vecteur moyen sans les vecteurs aberrants.
 *
 * @param vecteurs Les vecteurs à utiliser.
 * @param average_vecteurs Le vecteur moyen résultant.
 * @param nbVecteurs Le nombre de vecteurs à utiliser.
 */
void calculateAverageVecteursWithoutOutliers(DVecteur* vecteurs,
                                             DVecteur* average_vecteurs,
                                             int nbVecteurs);

/**
 * @brief Supprime les vecteurs avec une longueur inférieure à une certaine
 * valeur.
 *
 * @param vecteurs Les vecteurs à traiter.
 */
void removeSmallVecteurs(DVecteur* vecteurs);

/**
 * @brief Supprime les vecteurs avec un angle supérieur à une certaine limite.
 *
 * @param vecteurs Les vecteurs à traiter.
 */
void removeLargeAngleVecteur(DVecteur* vecteurs);

/**
 * @brief Fusionne deux vecteurs s'ils sont suffisamment proches.
 *
 * @param vecteurs Les vecteurs à fusionner.
 */
void mergeSameVecteurs(DVecteur* vecteurs);

/**
 * @brief Obtient l'angle d'un vecteur par rapport à l'axe des y.
 *
 * @param vecteur Le vecteur.
 * @return double L'angle du vecteur.
 */
double getVecteurAngle(Vecteur vecteur);

/**
 * @brief Obtient le côté sur lequel se trouve un vecteur par rapport à une
 * position donnée.
 *
 * @param vecteur Le vecteur.
 * @param middle La position de référence.
 * @return int Le côté du vecteur.
 */
int getVecteurSide(Vecteur vecteur, double middle);

/**
 * @brief Calcule l'erreur relative entre une valeur approchée et une valeur
 * exacte.
 *
 * @param valeur_approchee La valeur approchée.
 * @param valeur_exacte La valeur exacte.
 * @return double L'erreur relative.
 */
double erreur_relative(double valeur_approchee, double valeur_exacte);

/**
 * @brief Enregistre un vecteur de référence dans un contexte donné.
 *
 * @param ctx Le contexte dans lequel enregistrer le vecteur de référence.
 * @param vecteurs Le vecteur de référence.
 */
void saveReferenceVecteur(context* ctx, DVecteur vecteurs);

/**
 * @brief Affiche les coordonnées des vecteurs.
 *
 * @param vecteurs Les vecteurs à afficher.
 */
void printVecteur(DVecteur* vecteurs);

/**
 * @brief Obtient la coordonnée x correspondante à une coordonnée y dans
 * l'équation d'un vecteur.
 *
 * @param v Le vecteur.
 * @param y La coordonnée y.
 * @return int La coordonnée x.
 */
int getXWithYInEquationOfVecteur(Vecteur v, double y);

/**
 * @brief Maximise la longueur des vecteurs jusqu'au bord de l'image.
 *
 * @param vecteurs Les vecteurs à traiter.
 */
void maximizeDVector(DVecteur* vecteurs);

/**
 * @brief Calcule la distance entre deux points.
 *
 * @param a Le premier point.
 * @param b Le deuxième point.
 * @return double La distance entre les deux points.
 */
double getPointDistance(Point a, Point b);

/**
 * @brief Construit le deuxième vecteur à partir du premier vecteur et du
 * contexte.
 *
 * @param vecteurs Les vecteurs à utiliser.
 * @param ctx Le contexte.
 */
void buildSecondVecteur(DVecteur* vecteurs, context* ctx);

/**
 * @brief Calcule l'angle moyen entre deux vecteurs.
 *
 * @param vecteurs Les vecteurs à utiliser.
 * @return double L'angle moyen.
 */
double getMiddleAngle(DVecteur vecteurs);

void printVecteur(DVecteur* vecteurs) {
    LOG_INF(
        "m0 : (x0 : %f, y0 : %f), (x1 : %f, y1 : %f)\r\nm1 : (x0 : %f, y0 : "
        "%f), (x1 : %f, y1 : %f)",
        vecteurs->m[0].tail.x, vecteurs->m[0].tail.y, vecteurs->m[0].head.x,
        vecteurs->m[0].head.y, vecteurs->m[1].tail.x, vecteurs->m[1].tail.y,
        vecteurs->m[1].head.x, vecteurs->m[1].head.y);
}

void setNullVecteur(DVecteur* vecteurs) {
    for (int i = 0; i < 2; i++) {
        vecteurs->m[i].tail.x = 0;
        vecteurs->m[i].tail.y = 0;

        vecteurs->m[i].head.x = 0;
        vecteurs->m[i].head.y = 0;
    }
}
void pixyVecteursToDVecteurs(synapse_msgs_PixyVector pixy_vector,
                             DVecteur* vecteurs) {
    vecteurs->m[0].tail.x = pixy_vector.m0_x0;
    vecteurs->m[0].tail.y = pixy_vector.m0_y0;

    vecteurs->m[0].head.x = pixy_vector.m0_x1;
    vecteurs->m[0].head.y = pixy_vector.m0_y1;

    vecteurs->m[1].tail.x = pixy_vector.m1_x0;
    vecteurs->m[1].tail.y = pixy_vector.m1_y0;

    vecteurs->m[1].head.x = pixy_vector.m1_x1;
    vecteurs->m[1].head.y = pixy_vector.m1_y1;
}
void DVecteursToPixyVecteurs(DVecteur vecteurs,
                             synapse_msgs_PixyVector* pixy_vector) {
    pixy_vector->m0_x0 = vecteurs.m[0].tail.x;
    pixy_vector->m0_y0 = vecteurs.m[0].tail.y;

    pixy_vector->m0_x1 = vecteurs.m[0].head.x;
    pixy_vector->m0_y1 = vecteurs.m[0].head.y;

    pixy_vector->m1_x0 = vecteurs.m[1].tail.x;
    pixy_vector->m1_y0 = vecteurs.m[1].tail.y;

    pixy_vector->m1_x1 = vecteurs.m[1].head.x;
    pixy_vector->m1_y1 = vecteurs.m[1].head.y;
}
/* Return VECTEUR_FALSE if vector is non null*/
int isNullVecteur(Vecteur* vecteur) {
    if (!(vecteur->head.x < epsilon && vecteur->head.y < epsilon &&
          vecteur->tail.x < epsilon && vecteur->tail.y < epsilon)) {
        return VECTEUR_FALSE;
    }
    return VECTEUR_TRUE;
}

int getNbOfNonNullVecteurs(DVecteur* vecteurs) {
    int n = 0;
    int i = 0;
    for (i = 0; i < 2; i++) {
        n += (isNullVecteur(&vecteurs->m[i]) == VECTEUR_FALSE) ? 1 : 0;
    }
    return n;
}

void arrangeVecteurs(
    DVecteur* vecteurs) {  // fonction qui Ã©change (x0,y0) avec (x1,y1) si y0 >
                           // y1 pour avoir tjrs y0 < y1
    uint32_t tmp;
    int n = getNbOfNonNullVecteurs(vecteurs);
    int i = 0;
    for (i = 0; i < n; i++) {
        if (vecteurs->m[i].tail.y > vecteurs->m[i].head.y) {
            tmp = vecteurs->m[i].head.y;
            vecteurs->m[i].head.y = vecteurs->m[i].tail.y;
            vecteurs->m[i].tail.y = tmp;
            tmp = vecteurs->m[i].head.x;
            vecteurs->m[i].head.x = vecteurs->m[i].tail.x;
            vecteurs->m[i].tail.x = tmp;
        }
    }
}

void addVecteursToList(DVecteur vecteurs, context* ctx, int nbVecteurs) {
    ctx->nb_of_vects_stored =
        (ctx->nb_of_vects_stored == nbVecteurs) ? 0 : ctx->nb_of_vects_stored;
    ctx->oldVectors[ctx->nb_of_vects_stored] = vecteurs;
    ctx->nb_of_vects_stored++;
}

void calculateAverageVecteur(DVecteur* vecteurs, int size,
                             DVecteur* average_vecteur) {
    for (int i = 0; i < size; i++) {
        DVecteur* vecteur = &vecteurs[i];
        for (int j = 0; j < 2; j++) {
            average_vecteur->m[j].tail.x =
                average_vecteur->m[j].tail.x + vecteur->m[j].tail.x / size;
            average_vecteur->m[j].tail.y =
                average_vecteur->m[j].tail.y + vecteur->m[j].tail.y / size;
            average_vecteur->m[j].head.x =
                average_vecteur->m[j].head.x + vecteur->m[j].head.x / size;
            average_vecteur->m[j].head.y =
                average_vecteur->m[j].head.y + vecteur->m[j].head.y / size;
        }
    }
}

double calculateVecteursDistance(DVecteur v1, DVecteur v2) {
    int i;
    double somme = 0;
    for (i = 0; i < 2; i++) {
        somme += sqrt(pow((double)(v1.m[i].tail.x - v2.m[i].tail.x), 2) +
                      pow((double)(v1.m[i].tail.y - v2.m[i].tail.x), 2) +
                      pow((double)(v1.m[i].head.x - v2.m[i].head.x), 2) +
                      pow((double)(v1.m[i].head.y - v2.m[i].head.y), 2));
    }
    return somme;
}

void removeOutliersVecteurs(DVecteur* vecteurs, int* size, DVecteur* avg_vector,
                            double threshold) {
    calculateAverageVecteur(vecteurs, *size, avg_vector);
    int j = 0;
    for (int i = 0; i < *size; i++) {
        if (calculateVecteursDistance(vecteurs[i], *avg_vector) <= threshold) {
            vecteurs[j++] = vecteurs[i];
        }
    }
    *size = j;
}

void calculateAverageVecteursWithoutOutliers(DVecteur* vecteurs,
                                             DVecteur* average_vecteurs,
                                             int nbVecteurs) {
    int size = nbVecteurs;

    removeOutliersVecteurs(vecteurs, &size, average_vecteurs,
                           MAX_DISTANCE_FOR_SAME_VECT);
    calculateAverageVecteur(vecteurs, size, average_vecteurs);
}
void removeLargeAngleVecteur(DVecteur* vecteurs) {
    int m1_empty = 0;
    if (fabs(getVecteurAngle(vecteurs->m[1])) / M_PI * 180.0 >
        MAX_VECTOR_ANGLE_THRESHOLD) {
        m1_empty++;
    }
    if (fabs(getVecteurAngle(vecteurs->m[0])) / M_PI * 180.0 >
        MAX_VECTOR_ANGLE_THRESHOLD) {
        if (m1_empty == 1) {
            vecteurs->m[0].tail.x = 0;
            vecteurs->m[0].tail.y = 0;
            vecteurs->m[0].head.x = 0;
            vecteurs->m[0].head.y = 0;
        } else {
            vecteurs->m[0].tail.x = vecteurs->m[1].tail.x;
            vecteurs->m[0].tail.y = vecteurs->m[1].tail.y;
            vecteurs->m[0].head.x = vecteurs->m[1].head.x;
            vecteurs->m[0].head.y = vecteurs->m[1].head.y;
        }
    }
    if (m1_empty == 1) {
        vecteurs->m[1].tail.x = 0;
        vecteurs->m[1].tail.y = 0;
        vecteurs->m[1].head.x = 0;
        vecteurs->m[1].head.y = 0;
    }
}
void removeSmallVecteurs(DVecteur* vecteurs) {
    int m1_empty = 0;
    if ((int)(vecteurs->m[1].head.y - vecteurs->m[1].tail.y) <
        MIN_VECTOR_LENGTH) {
        m1_empty = 1;
    }
    if ((int)(vecteurs->m[0].head.y - vecteurs->m[0].tail.y) <
        MIN_VECTOR_LENGTH) {
        if (m1_empty == 1) {
            vecteurs->m[0].head.y = 0;
            vecteurs->m[0].tail.y = 0;
            vecteurs->m[0].head.x = 0;
            vecteurs->m[0].tail.x = 0;
        } else {
            vecteurs->m[0].head.y = vecteurs->m[1].head.y;
            vecteurs->m[0].tail.y = vecteurs->m[1].tail.y;
            vecteurs->m[0].head.x = vecteurs->m[1].head.x;
            vecteurs->m[0].tail.x = vecteurs->m[1].tail.x;
        }
    }
    if (m1_empty == 1) {
        vecteurs->m[1].head.y = 0;
        vecteurs->m[1].tail.y = 0;
        vecteurs->m[1].head.x = 0;
        vecteurs->m[1].tail.x = 0;
    }
}

void mergeSameVecteurs(DVecteur* vecteurs) {
    if (abs((int)(vecteurs->m[1].tail.x - vecteurs->m[0].tail.x)) <
            SAME_VECTOR_THRESHOLD &&
        abs((int)(vecteurs->m[1].head.x - vecteurs->m[0].head.x)) <
            SAME_VECTOR_THRESHOLD) {
        vecteurs->m[0].tail.x =
            (vecteurs->m[1].tail.x + vecteurs->m[0].tail.x) / 2;
        vecteurs->m[0].tail.y =
            (vecteurs->m[1].tail.y + vecteurs->m[0].tail.y) / 2;
        vecteurs->m[0].head.x =
            (vecteurs->m[1].head.x + vecteurs->m[0].head.x) / 2;
        vecteurs->m[0].head.y =
            (vecteurs->m[1].head.y + vecteurs->m[0].head.y) / 2;

        vecteurs->m[1].tail.x = 0;
        vecteurs->m[1].tail.y = 0;
        vecteurs->m[1].head.x = 0;
        vecteurs->m[1].head.y = 0;
    }
}

double getVecteurAngle(Vecteur vecteur) {
    int32_t dx;
    int32_t dy;
    dx = vecteur.head.x - vecteur.tail.x;
    dy = vecteur.head.y - vecteur.tail.y;
    return atan2(dx, dy);
}

int getVecteurSide(Vecteur vecteur, double middle) {
    if (vecteur.head.x < middle) {
        return VECTOR_ON_THE_LEFT;
    }
    return VECTOR_ON_THE_RIGHT;
}

double erreur_relative(double valeur_approchee, double valeur_exacte) {
    return (valeur_exacte - valeur_approchee) / fabs(valeur_exacte);
}

void saveReferenceVecteur(context* ctx, DVecteur vecteurs) {
    LOG_INF("=========");
    printVecteur(&vecteurs);
    LOG_INF("=========");
    Vecteur middle;
    getMiddleVecteur(vecteurs, &middle);
    ctx->first_vector_saved = 1;
    ctx->first_vector = vecteurs;
    ctx->first_vector_angle_left = getVecteurAngle(vecteurs.m[0]);
    ctx->first_vector_angle_right = getVecteurAngle(vecteurs.m[1]);

    ctx->first_vector_middle = (double)middle.head.x;
    ctx->beta_ref = atan2(vecteurs.m[0].head.x - vecteurs.m[0].tail.x,
                          vecteurs.m[0].head.y - vecteurs.m[0].tail.y);
    ctx->sigma_ref = atan2(vecteurs.m[1].head.x - vecteurs.m[1].tail.x,
                           vecteurs.m[1].head.y - vecteurs.m[1].tail.y);s
    ctx->head_distance_ref =
        getPointDistance(vecteurs.m[0].head, vecteurs.m[1].head);
    ctx->tail_distance_ref =
        getPointDistance(vecteurs.m[0].tail, vecteurs.m[1].tail);
    ctx->angle_ref = getMiddleAngle(middle);
}
int getXWithYInEquationOfVecteur(Vecteur v, double y) {
    double a = (double)(v.head.y - v.tail.y) / (double)(v.head.x - v.tail.x);
    double b = v.head.y - a * v.head.x;
    return (y - b) / a;
}
void maximizeDVector(DVecteur* vecteurs) {
    vecteurs->m[0].head.x =
        getXWithYInEquationOfVecteur(vecteurs->m[0], IMAGE_HEIGHT);
    vecteurs->m[1].head.x =
        getXWithYInEquationOfVecteur(vecteurs->m[1], IMAGE_HEIGHT);
    vecteurs->m[0].head.y = IMAGE_HEIGHT;
    vecteurs->m[1].head.y = IMAGE_HEIGHT;

    vecteurs->m[0].tail.x = getXWithYInEquationOfVecteur(vecteurs->m[0], 0.0);
    vecteurs->m[1].tail.x = getXWithYInEquationOfVecteur(vecteurs->m[1], 0.0);
    vecteurs->m[0].tail.y = 0.0;
    vecteurs->m[1].tail.y = 0.0;
}

double getPointDistance(Point a, Point b) {
    return sqrt(powf((a.x - b.x), 2.0) + powf((a.y - b.y), 2.0));
}
void buildSecondVecteur(DVecteur* vecteurs, context* ctx) {
    Vecteur working_vecteur = vecteurs->m[0];

    double l = 1.0;
    double ref_angle = ctx->beta_ref;
    Vecteur ref_vecteur = ctx->first_vector.m[0];

    if (getVecteurSide(working_vecteur, IMAGE_WIDTH / 2) !=
        VECTOR_ON_THE_LEFT) {
        l = -1.0;
        ref_angle = ctx->sigma_ref;
        ref_vecteur = ctx->first_vector.m[1];
    }

    double omega =
        getPointDistance(working_vecteur.head, working_vecteur.tail) /
        getPointDistance(ref_vecteur.head, ref_vecteur.tail);
    double dist_head = omega * ctx->head_distance_ref;
    double beta = atan2(working_vecteur.head.x - working_vecteur.tail.x,
                        working_vecteur.head.y - working_vecteur.tail.y);
    double angle1 = M_PI + l * beta - fabs(ref_angle);
    vecteurs->m[1].head.y = working_vecteur.head.y + cos(angle1) * dist_head;
    vecteurs->m[1].head.x =
        working_vecteur.head.x + l * sin(angle1) * dist_head;

    double dist_tail = omega * ctx->tail_distance_ref;
    double angle2 = M_PI / 2 - angle1;

    vecteurs->m[1].tail.y = working_vecteur.tail.y + dist_tail * sin(angle2);
    vecteurs->m[1].tail.x =
        working_vecteur.tail.x + l * dist_tail * cos(angle2);
}
double getMiddleAngle(Vecteur middle) {
    return atan2(middle.head.x - middle.tail.x, middle.head.y - middle.tail.y);
}
void getMiddleVecteur(DVecteur vecteurs, Vecteur * middle)
{
    double middle_head =
        getPointDistance(vecteurs.m[0].head, vecteurs.m[1].head) / 2.0;
    double middle_tail =
        getPointDistance(vecteurs.m[0].tail, vecteurs.m[1].tail) / 2.0;
    double beta = atan2(vecteurs.m[1].head.y - vecteurs.m[0].head.y,
                        vecteurs.m[1].head.x - vecteurs.m[0].head.x);
    middle->head.x = vecteurs.m[0].head.x + cos(fabs(beta)) * middle_head;
    middle->head.y = vecteurs.m[0].head.y + sin(beta) * middle_head;
    double beta2 = atan2(vecteurs.m[1].tail.y - vecteurs.m[0].tail.y,
                         vecteurs.m[1].tail.x - vecteurs.m[0].tail.x);
    middle->tail.x = vecteurs.m[0].tail.x + cos(fabs(beta2)) * middle_tail;
    middle->tail.y = vecteurs.m[0].tail.y + sin(beta2) * middle_tail;
}
#endif
```

## src/velocity.c
```c
/**
 * @file velocity.c
 * @brief Fichier pour la gestion de la conduite automatique.
 *
 * @author Antoine Guillermin
 * @date 2024-04-18
 * @version 1.501
 */
#include "velocity.h" 

// Fonction pour calculer le gain de direction en fonction de l'angle
double gain_steer(double x) {
    if (x > 100.0) { // Si x est supérieur à 100
        x = 100.0; // On fixe x à 100
    }
   int q = (int)((x-fmod(x,10.0)) / 10); // On calcule la partie entière de x/10
    return (steers[q + 1] - steers[q]) / 10.0 * (x - (double)q * 10.0) + steers[q]; // On retourne le gain de direction calculé
}

// Fonction pour calculer le gain de vitesse en fonction de l'angle
double gain_speed(double x) {
    if (x > 100.0) { // Si x est supérieur à 100
        x = 100.0; // On fixe x à 100
    }
    int q = (int)((x-fmod(x,10.0)) / 10); // On calcule la partie entière de x/10
    return (speeds[q + 1] - seeds[q]) / 10.0 * (x - (double)q * 10.0) + speeds[q]; // On retourne le gain de vitesse calculé
}

// Fonction pour afficher les informations de direction, vecteurs, nombre de vecteurs et omega_fwd
void print_info(DVecteur vecteurs, int nbVectors,double angle_observed,
				double steer,
				double speed,
				double steer_gain,
				double speed_gain)
{
    LOG_INF("                                                     \
            {                                                     \
            Timestamp: %lld,                                      \
            Nb_vectors:%d,                                        \
            m0:{                                                  \
				x0: %f,                                           \
				y0: %f,  										  \
				x1: %f,   										  \
				y1: %f                                            \
			},                                                    \
            m1:{                                                  \
				x0: %f,                                           \
				y0: %f,                                           \
				x1: %f,                                           \
				y1: %f                                            \
			},                                                    \
			angle_observed: %f,                                   \
			steer: %f,                                            \
			speed: %f,                                            \
			steer_gain: %f                                        \
            }",
                k_uptime_get(), // Récupère le temps écoulé depuis le démarrage du système
                nbVectors, // Affiche le nombre de vecteurs
                vecteurs.m[0].tail.x, // Affiche x0 du vecteur m0
                vecteurs.m[0].tail.y, // Affiche y0 du vecteur m0
                vecteurs.m[0].head.x, // Affiche x1 du vecteur m0
                vecteurs.m[0].head.y, // Affiche y1 du vecteur m0
                vecteurs.m[1].tail.x, // Affiche x0 du vecteur m1
                vecteurs.m[1].tail.y, // Affiche y0 du vecteur m1
                vecteurs.m[1].head.x, // Affiche x1 du vecteur m1
                vecteurs.m[1].head.y,
				angle_observed,
				steer,
				speed,
				steer_gain
				); // Affiche y1 du vecteur m1
}

// Fonction pour saturer la direction
double steer_saturation(double steer)
{
    if(steer>100){ // Si steer est supérieur à 100
        steer=100; // On fixe steer à 100
    }else if(steer < -100){ // Si steer est inférieur à -100
        steer=-100; // On fixe steer à -100
    }
    return steer; // On retourne steer
}

// Fonction pour saturer la vitesse
double speed_saturation(double speed)
{
    if(speed>100){ // Si speed est supérieur à 100
        speed=100; // On fixe speed à 100
    }else if(speed <=0){ // Si speed est inférieur ou égal à 0
        speed= 0; // On fixe speed à 0
    }
    return speed; // On retourne speed
}



static void follow_line(context* ctx)
{
    double steer = 0.0; // Initialise steer à 0
    double speed = 0.0; // Initialise speed à 0
    DVecteur vecteurs; // Déclare une variable vecteurs de type DVecteur
    pixyVecteursToDVecteurs(ctx->pixy_vector,&vecteurs); // Convertit les vecteurs Pixy en DVecteurs
    double angle_percent;
	double steer_gain;
	
    int num_vectors = getNbOfNonNullVecteurs(&vecteurs); // Obtient le nombre de vecteurs non nuls
    arrangeVecteurs(&vecteurs); // Arrange les vecteurs
    addVecteursToList(vecteurs,ctx,NB_OF_VECTS_TO_WAIT); // Ajoute les vecteurs à la liste
    if(ctx->nb_of_vects_stored == NB_OF_VECTS_TO_WAIT){ // Si le nombre de vecteurs stockés est égal à NB_OF_VECTS_TO_WAIT
        DVecteur average_vecteurs; // Déclare une variable average_vecteurs de type DVecteur
        setNullVecteur(&average_vecteurs); // Met à zéro average_vecteurs
        calculateAverageVecteursWithoutOutliers(ctx->oldVectors,&average_vecteurs,NB_OF_VECTS_TO_WAIT); // Calcule la moyenne des vecteurs sans les valeurs aberrantes
        removeSmallVecteurs(&average_vecteurs); // Supprime les petits vecteurs
        removeLargeAngleVecteur(&average_vecteurs); // Supprime les vecteurs avec un grand angle
       mergeSameVecteurs(&average_vecteurs); // Fusionne les vecteurs similaires dans average_vecteurs
        num_vectors = getNbOfNonNullVecteurs(&average_vecteurs); // Obtient le nombre de vecteurs non nuls dans average_vecteurs

        // Si aucun vecteur n'est détecté, on arrête la voiture
        if(num_vectors  == 0) {
            // Si c'est la première fois qu'aucun vecteur n'est détecté
            if(ctx->no_line_time == 0){
                ctx->no_line_time=k_uptime_get(); // Enregistre le temps actuel
                steer = ctx->prev_steer; // Utilise la dernière valeur de direction
                speed=NO_VECTOR_SPEED; // Définit la vitesse à NO_VECTOR_SPEED
                LOG_INF("\r\nFirst vector\r\n"); // Affiche un message d'information
            }
            // Si cela fait plus de NO_LINE_TIME ms qu'aucun vecteur n'a été détecté
            else if(k_uptime_get() - ctx->no_line_time >= NO_LINE_TIME) {
                speed = 0.0; // Arrête la voiture
                steer = 0.0; // Arrête de tourner
                LOG_INF("\r\n No vectors, stopping"); // Affiche un message d'information
            }
            else{
                LOG_INF("\r\n %lld ms without any vectors", k_uptime_get() - ctx->no_line_time); // Affiche le temps écoulé depuis la dernière détection de vecteur
                speed = NO_VECTOR_SPEED; // Continue à la même vitesse
                steer =ctx->prev_steer; // Continue à tourner dans la même direction
            }

            // Si la direction est supérieure à INCREASE_STEER_IF_NO_VECTORS_THRESHOLD
            if(steer > INCREASE_STEER_IF_NO_VECTORS_THRESHOLD){
                steer+=INCREASE_STEER_IF_NO_VECTORS; // Augmente la direction
            }
            // Si la direction est inférieure à -INCREASE_STEER_IF_NO_VECTORS_THRESHOLD
            else if(steer < -INCREASE_STEER_IF_NO_VECTORS_THRESHOLD){
                steer-=INCREASE_STEER_IF_NO_VECTORS; // Diminue la direction
            }
        }
        // Si deux vecteurs sont détectés et que le premier vecteur n'a pas encore été enregistré
        else if(num_vectors == 2 && ctx->first_vector_saved == 0){
            maximizeDVector(&average_vecteurs); // Maximise average_vecteurs
            saveReferenceVecteur(ctx,average_vecteurs); // Enregistre le vecteur de référence
        }
        else{
            // Si un seul vecteur est détecté et que le premier vecteur a été enregistré
            if(num_vectors == 1 && ctx->first_vector_saved == 1){
                buildSecondVecteur(&average_vecteurs,ctx); // Construit le second vecteur
                num_vectors++; // Incrémente le nombre de vecteurs
            }
            // Si deux vecteurs sont détectés
            if(num_vectors == 2){
                ctx->no_line_time = 0; // Réinitialise le temps sans détection de ligne
                Vecteur middle;
                getMiddleVecteur(average_vecteurs, &middle);
                double angle_antoine = (getMiddleAngle(middle) -ctx->angle_ref)*100/M_PI; // Calcule l'angle du vecteur central moins l'erreur statique du début et met cet angle en %
                 angle_percent = angle_antoine*100.0/15.0; // Applique un premier gain pour augmenter les petits angles

                 steer_gain = gain_steer(fabs(angle_percent) > 100.0):1.0; // Calcule le gain de direction
                steer =  steer_gain*angle_percent; // Calcule la nouvelle direction
				 speed = gain_speed(fabs(angle_percent)); // Calcule la vitesse
                LOG_INF("angle: %f, angle(percent): %f, gain: %f, steer : %f",angle_antoine,angle_percent,steer_gain,steer); // Affiche les informations de direction
            }
            steer= steer_saturation(steer); // Sature la direction
            ctx->prev_steer = steer; // Enregistre la direction actuelle
           
            speed = speed_saturation(speed); // Sature la vitesse
			if(num_vectors == 2){
			print_info(average_vecteurs, num_vectors,angle_percent,steer,speed, steer_gain);
			}
            steer = steer*STEER_FACTOR; // Applique le facteur de direction
            ctx->prev_speed = speed; // Enregistre la vitesse actuelle
            double omega_fwd=speed*SPEED_FACTOR; // Calcule la vitesse avant
            b3rb_set_actuators(&ctx->actuators, steer, omega_fwd); // Met à jour les actionneurs
        }
    }
}

// Plus utilisée - Fonction pour obtenir l'angle de référence d'un côté
double get_ref_angle_of_side(context* ctx, Vecteur vecteur)
{   
    return (getVecteurSide(vecteur, ctx->first_vector_middle) == VECTOR_ON_THE_LEFT) ? ctx->first_vector_angle_left : ctx->first_vector_angle_right;
}


static void stop(context* ctx)
{
    b3rb_set_actuators(&ctx->actuators, 0, 0);
}

static void b3rb_velocity_entry_point(void* p0, void* p1, void* p2)
{
    LOG_INF("init");
    context* ctx = p0;
    ARG_UNUSED(p1);
    ARG_UNUSED(p2);

    init_b3rb_vel(ctx);

    while (true) {
        synapse_msgs_Status_Mode mode = ctx->status.mode;

        int rc = 0;
        if (mode == synapse_msgs_Status_Mode_MODE_MANUAL) {
            struct k_poll_event events[] = {
                *zros_sub_get_event(&ctx->sub_actuators_manual),
            };
            rc = k_poll(events, ARRAY_SIZE(events), K_MSEC(1000));
            if (rc != 0) {
                LOG_DBG("not receiving manual actuators");
            }
        } else if(mode == synapse_msgs_Status_Mode_MODE_CMD_VEL){
            struct k_poll_event events[] = {
                *zros_sub_get_event(&ctx->sub_cmd_vel),
            };
            rc = k_poll(events, ARRAY_SIZE(events), K_MSEC(1000));
            if (rc != 0) {
                LOG_DBG("not receiving cmd_vel");
            }
        } else {
            struct k_poll_event events[] = {
                *zros_sub_get_event(&ctx->sub_pixy_vector),
            };
            rc = k_poll(events, ARRAY_SIZE(events), K_MSEC(1000));
            if (rc != 0) {
                LOG_DBG("not receiving pixy_vector");
            }
        }

        if (zros_sub_update_available(&ctx->sub_status)) {
            zros_sub_update(&ctx->sub_status);
        }

        if (zros_sub_update_available(&ctx->sub_cmd_vel)) {
            zros_sub_update(&ctx->sub_cmd_vel);
        }

        if (zros_sub_update_available(&ctx->sub_actuators_manual)) {
            zros_sub_update(&ctx->sub_actuators_manual);
        }
        if (zros_sub_update_available(&ctx->sub_pixy_vector)) {
            zros_sub_update(&ctx->sub_pixy_vector);
        }
        #ifdef AUTO_START 
         #ifdef CONFIG_CEREBRI_SENSE_SAFETY
            if(ctx->status.safety == synapse_msgs_Status_Safety_SAFETY_UNSAFE && ctx->status.mode != synapse_msgs_Status_Mode_MODE_MANUAL){
            ctx->status.mode = synapse_msgs_Status_Mode_MODE_AUTO;
            ctx->status.arming = synapse_msgs_Status_Arming_ARMING_ARMED;
            }
            #endif
        #endif
        // handle modes
        if (rc < 0) {
            stop(ctx);
            LOG_DBG("no data, stopped");
        } else if (ctx->status.arming != synapse_msgs_Status_Arming_ARMING_ARMED) {
            stop(ctx);
            LOG_DBG("not armed, stopped");
        } else if (ctx->status.mode == synapse_msgs_Status_Mode_MODE_MANUAL) {
            LOG_DBG("manual mode");
            ctx->actuators = ctx->actuators_manual;
        } else if(ctx->status.mode == synapse_msgs_Status_Mode_MODE_AUTO){
            LOG_DBG("auto mode");
            follow_line(ctx);
        }else{
            LOG_DBG("cmd_vel mode");
            update_cmd_vel(ctx);
        }

        // publish
        zros_pub_update(&ctx->pub_actuators);
    }
}

K_THREAD_DEFINE(b3rb_velocity, MY_STACK_SIZE,
    b3rb_velocity_entry_point, &g_ctx, NULL, NULL,
    MY_PRIORITY, 0, 1000);

/* vi: ts=4 sw=4 et */
```

## src/velocity.h
```c
/**
 * @file velocity.h
 * @brief Fichier d'en-tête pour la gestion de la conduite automatique.
 *
 * @author Antoine Guillermin
 * @date 2024-01-20
 * @version 1.501
 */
#ifndef VELOCITY
#define VELOCITY

#include "casadi/gen/b3rb.h" ///< Inclut le fichier d'en-tête pour le générateur de b3rb.
#include "math.h" ///< Inclut le fichier d'en-tête pour les fonctions mathématiques.
#include <zephyr/logging/log.h> ///< Inclut le fichier d'en-tête pour la journalisation de Zephyr.

#include <zephyr/kernel.h> ///< Inclut le fichier d'en-tête pour récupérer le temps.

// Définitions des constantes
#define VECTOR_ON_THE_LEFT 1 ///< Définit le côté gauche pour un vecteur.
#define VECTOR_ON_THE_RIGHT 0 ///< Définit le côté droit pour un vecteur.
#define M_PI 3.14159265358979323846 ///< Définit la valeur de Pi.
#define IMAGE_WIDTH 78 ///< Définit la largeur de l'image.
#define IMAGE_HEIGHT 51 ///< Définit la hauteur de l'image.
#define STEER_MAX 0.6 ///< Définit la direction maximale.
#define SPEED_MAX 36.0 ///< Définit la vitesse maximale.
#define WHEEL_RADIUS 34 ///< Définit le rayon de la roue.
#define LEFT_OR_RIGHT_COEFF -1 ///< Définit le coefficient pour le côté gauche ou droit.
#define AUTO_START ///< Définit le démarrage automatique.

// Paramètres pour éliminer les vecteurs "mauvais"
#define MIN_VECTOR_LENGTH 20 ///< Utilisé pour éliminer les vecteurs inférieurs à cette taille (y1-y0), plus la valeur est basse moins il y aura de fusion (-1 <=> pas de fusion)
#define NO_LINE_TIME 3500 ///< Définit le temps sans ligne.
#define NB_OF_VECTS_TO_WAIT 1 ///< Définit le nombre de vecteurs à attendre.
#define MAX_DISTANCE_FOR_SAME_VECT 30 ///< Utilisé pour éliminer les vecteurs "aberrants" lorsqu'on calcule les moyennes de m0 et m1, plus la valeur est grande moins il y aura de vecteurs éliminés.
#define SAME_VECTOR_THRESHOLD 20 ///< Utilisé pour fusionner m0 et m1 s'ils sont "proches", plus la valeur est basse moins il y aura de fusion (-1 <=> pas de fusion).
#define IMAGE_WIDTH_THRESHOLD 0 ///< Définit le seuil de largeur de l'image.
#define MAX_VECTOR_ANGLE_THRESHOLD 60 ///< Utilisé pour supprimer les vecteurs qui ont un angle supérieur à ceci (en degré).

// Paramètres de vitesse en %
#define NO_VECTOR_SPEED 50.0 ///< Définit la vitesse sans vecteur.

// Paramètres de rotation en %
#define INCREASE_STEER_IF_NO_VECTORS 5.0 ///< Définit l'augmentation de la direction si aucun vecteur.
#define INCREASE_STEER_IF_NO_VECTORS_THRESHOLD 60.0 ///< Définit le seuil d'augmentation de la direction si aucun vecteur.

// Non modifiable
#define SPEED_FACTOR SPEED_MAX/100.0 ///< Facteur de vitesse, max speed = 36 et on divise par 100.0 car on a un coefficient en %.
#define STEER_FACTOR STEER_MAX/100.0 ///< Facteur de direction, max steer = 0.6 et on divise par 100.0 car on a un coefficient en %.

#include <zros/private/zros_node_struct.h> ///< Inclut le fichier d'en-tête pour la structure de noeud ZROS.
#include <zros/private/zros_pub_struct.h> ///< Inclut le fichier d'en-tête pour la structure de publication ZROS.
#include <zros/private/zros_sub_struct.h> ///< Inclut le fichier d'en-tête pour la structure de souscription ZROS.
#include <zros/zros_node.h> ///< Inclut le fichier d'en-tête pour le noeud ZROS.
#include <zros/zros_pub.h> ///< Inclut le fichier d'en-tête pour la publication ZROS.
#include <zros/zros_sub.h> ///< Inclut le fichier d'en-tête pour la souscription ZROS.

#include <cerebri/core/casadi.h> ///< Inclut le fichier d'en-tête pour le noyau Cerebri.
#include <stdio.h> ///< Inclut le fichier d'en-tête pour les fonctions d'entrée/sortie standard.
#include <math.h> ///< Inclut le fichier d'en-tête pour les fonctions mathématiques.
#include <stdlib.h> ///< Inclut le fichier d'en-tête pour les fonctions de la bibliothèque standard.
#include "mixing.h" ///< Inclut le fichier d'en-tête pour les fonctions de mixage.

#define MY_STACK_SIZE 3072 ///< Définit la taille de la pile.
#define MY_PRIORITY 4 ///< Définit la priorité.

LOG_MODULE_REGISTER(b3rb_velocity, CONFIG_CEREBRI_B3RB_LOG_LEVEL); ///< Enregistre le module de journalisation pour la vitesse b3rb.

// Direction à (%)        0    10    20    30    40    50    60    70    80    90   100   100
const steers[] = {0.30, 0.30, 0.30, 0.30, 0.30, 0.35, 0.40, 0.70, 0.80, 0.85, 0.90, 0.90}; ///< Tableau des valeurs de gain direction.
const speeds[] = {100.0,100.0,100.0,90.0, 80.0, 80.0, 70.0, 70.0, 60.0, 60.0, 60.0, 60.0}; ///< Tableau des valeurs de vitesse.

/**
 * @brief Structure pour un point.
 */
typedef struct _Point {
    double x; ///< Coordonnée x du point.
    double y; ///< Coordonnée y du point.
} Point;

/**
 * @brief Structure pour un vecteur.
 */
typedef struct _Vecteur {
    Point tail; ///< Queue du vecteur.
    Point head; ///< Tête du vecteur.
} Vecteur;

/**
 * @brief Structure pour un DVecteur.
 */
typedef struct _DVecteur {
    Vecteur m[2]; ///< Tableau de deux vecteurs.
} DVecteur;

/**
 * @brief Structure pour le contexte.
 */
typedef struct _context {
    struct zros_node node; ///< Noeud ZROS.
    synapse_msgs_Twist cmd_vel; ///< Commande de vitesse.
    synapse_msgs_Status status; ///< Statut.
    synapse_msgs_Actuators actuators; ///< Actionneurs.
    synapse_msgs_Actuators actuators_manual; ///< Actionneurs manuels.
    synapse_msgs_PixyVector pixy_vector; ///< Vecteur Pixy.
    struct zros_sub sub_status, sub_cmd_vel, sub_actuators_manual, sub_pixy_vector; ///< Souscriptions.
    struct zros_pub pub_actuators; ///< Publications.
    const double wheel_radius; ///< Rayon de la roue.
    const double wheel_base; ///< Base de la roue.
    int64_t no_line_time; ///< Temps sans ligne.
    double prev_steer; ///< Direction précédente.
    double prev_speed; ///< Vitesse précédente.
    int nb_of_vects_stored; ///< Nombre de vecteurs stockés.
    DVecteur oldVectors[NB_OF_VECTS_TO_WAIT]; ///< Anciens vecteurs.
    DVecteur first_vector; ///< Premier vecteur.
    int first_vector_saved; ///< Premier vecteur sauvegardé.
    double first_vector_angle_left; ///< Angle du premier vecteur à gauche.
    double first_vector_angle_right; ///< Angle du premier vecteur à droite.
    double first_vector_middle; ///< Milieu du premier vecteur.
    double beta_ref; ///< Référence beta.
    double sigma_ref; ///< Référence sigma.
    double head_distance_ref; ///< Référence de distance de tête.
    double tail_distance_ref; ///< Référence de distance de queue.
    double angle_ref; ///< Référence d'angle.
} context;

/**
 * @brief Initialisation du contexte.
 */
static context g_ctx = {
    .node = {},
    .cmd_vel = synapse_msgs_Twist_init_default,
    .status = synapse_msgs_Status_init_default,
    .actuators = synapse_msgs_Actuators_init_default,
    .actuators_manual = synapse_msgs_Actuators_init_default,
    .pixy_vector=synapse_msgs_PixyVector_init_default,
    .sub_status = {},
    .sub_cmd_vel = {},
    .sub_actuators_manual = {},
    .pub_actuators = {},
    .wheel_radius = CONFIG_CEREBRI_B3RB_WHEEL_RADIUS_MM / 1000.0, // Il va falloir qu'on remesure le rayon de nos roues
    .wheel_base = CONFIG_CEREBRI_B3RB_WHEEL_BASE_MM / 1000.0,
    .no_line_time = 0, // Ajout Antoine
    .prev_speed=0,
    .prev_steer=0,
    .nb_of_vects_stored=0,
    .first_vector_middle=0.0,
    .beta_ref=0.0,
    .sigma_ref=0.0,
    .head_distance_ref=0.0,
    .tail_distance_ref=0.0,
    .angle_ref=0.0,
};

#include "./vector_utility.h" ///< Inclut le fichier d'en-tête pour les utilitaires de vecteur.

/**
 * @brief Construit les coefficients.
 */
void build_coefficients(void);

/**
 * @brief Calcule le gain de direction en fonction de l'angle (en %).
 * @param x Valeur de l'angle pour laquelle calculer le gain.
 * @return Le gain de direction.
 */
double gain_steer(double x);

/**
 * @brief Calcule la vitesse en fonction de l'angle (en %).
 * @param x Valeur de l'angle pour laquelle calculer le gain.
 * @return Le gain de vitesse.
 */
double gain_speed(double x);

/**
 * @brief Affiche les informations.
 * @param steer Direction.
 * @param vecteurs Vecteurs.
 * @param nbVectors Nombre de vecteurs.
 * @param omega_fwd Vitesse avant.
 */
void print_info(double steer,  DVecteur vecteurs, int nbVectors,double omega_fwd);

/**
 * @brief Sature la vitesse.
 * @param speed Vitesse à saturer.
 * @return La vitesse saturée.
 */
double speed_saturation(double speed);

/**
 * @brief Sature la direction.
 * @param steer Direction à saturer.
 * @return La direction saturée.
 */
double steer_saturation(double steer);

/**
 * @brief Obtient l'angle de référence du côté.
 * @param ctx Contexte.
 * @param vecteur Vecteur.
 * @return L'angle de référence du côté.
 */
double get_ref_angle_of_side(context* ctx, Vecteur vecteur);
#endif
```
